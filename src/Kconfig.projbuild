## src/Kconfig.projbuild
```kconfig
menu "Configuração do Wifi Configuration"

    config ESP_WIFI_SSID
        string "WiFi SSID"
        default "ssid"
        help
            Nome da rede Wifi.

    config ESP_WIFI_PASSWORD
        string "Senha do Wifi"
        default "minha_senha"
        help
            Senha do WiFi (WPA or WPA2).

    config ESP_MAXIMUM_RETRY
        int "Número máximo de tentativas de conexão"
        default 5
        help
            Configure o valor máximo de tentativas de conexão.

    config IPSTACK_API_KEY
        string "Key da API do Ipstack"
        default "12b592c8b219620b2b8dbbd0ddc3f3a5"

    config OPEN_WEATHER_API_KEY
        string "Key da API do Open Weather"
        default "7b8a29f9b93a78a05b2eaf12478b2ad9"
endmenu
```
